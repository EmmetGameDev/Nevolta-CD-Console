#include <Arduino.h>
#include <Bounce2.h>
#include <BleGamepad.h>

#define SSD1306_NO_SPLASH

#include <Wire.h>
#include <SPI.h>
#include <Adafruit_GFX.h>
#include <Adafruit_SSD1306.h>

#define CHARGE_ADC_PIN 5
#define BATTERY_ADC_PIN 4
const float DIVIDER_RATIO = 2.0f;
bool chargingMode = false;

unsigned long bat_previousMillis = 0;
unsigned long bat_interval = 5000;
int bat_lastReport = 0;

unsigned long previousMillis = 0;
unsigned long interval = 10000;

bool lastPairedState = false;

// Battery icons
static const unsigned char PROGMEM Batt_100[] = 
{
// 'Batt_100', 20x10px
0xff, 0xff, 0xe0, 0x80, 0x00, 0x20, 0xbf, 0xff, 0xb0, 0xbf, 0xff, 0xb0, 0xbf, 0xff, 0xb0, 0xbf, 
0xff, 0xb0, 0xbf, 0xff, 0xb0, 0xbf, 0xff, 0xb0, 0x80, 0x00, 0x20, 0xff, 0xff, 0xe0
};

static const unsigned char PROGMEM Batt_80[] = 
{
// 'Batt_80', 20x10px
0xff, 0xff, 0xe0, 0x80, 0x00, 0x20, 0xbf, 0xfc, 0x30, 0xbf, 0xfc, 0x30, 0xbf, 0xfc, 0x30, 0xbf, 
0xfc, 0x30, 0xbf, 0xfc, 0x30, 0xbf, 0xfc, 0x30, 0x80, 0x00, 0x20, 0xff, 0xff, 0xe0
};

static const unsigned char PROGMEM Batt_60[] = 
{
// 'Batt_60', 20x10px
0xff, 0xff, 0xe0, 0x80, 0x00, 0x20, 0xbf, 0xe0, 0x30, 0xbf, 0xe0, 0x30, 0xbf, 0xe0, 0x30, 0xbf, 
0xe0, 0x30, 0xbf, 0xe0, 0x30, 0xbf, 0xe0, 0x30, 0x80, 0x00, 0x20, 0xff, 0xff, 0xe0
};

static const unsigned char PROGMEM Batt_40[] = 
{
// 'Batt_40', 20x10px
0xff, 0xff, 0xe0, 0x80, 0x00, 0x20, 0xbf, 0x00, 0x30, 0xbf, 0x00, 0x30, 0xbf, 0x00, 0x30, 0xbf, 
0x00, 0x30, 0xbf, 0x00, 0x30, 0xbf, 0x00, 0x30, 0x80, 0x00, 0x20, 0xff, 0xff, 0xe0
};

static const unsigned char PROGMEM Batt_20[] = 
{
// 'Batt_20', 20x10px
0xff, 0xff, 0xe0, 0x80, 0x00, 0x20, 0xb8, 0x00, 0x30, 0xa8, 0x00, 0x30, 0xa8, 0x00, 0x30, 0xa8, 
0x00, 0x30, 0xa8, 0x00, 0x30, 0xb8, 0x00, 0x30, 0x80, 0x00, 0x20, 0xff, 0xff, 0xe0
};

static const unsigned char PROGMEM Batt_Charge[] = 
{
// 'Batt_Charge', 10x10px
0x0f, 0xc0, 0x1f, 0x80, 0x3f, 0x00, 0x7e, 0x00, 0xf8, 0x00, 0x7f, 0x00, 0x0e, 0x00, 0x1c, 0x00, 
0x38, 0x00, 0x30, 0x00
};

static const unsigned char PROGMEM SpacePad_Logo[] = 
{
// 'SpacePad', 128x32px
0x00, 0x00, 0x00, 0x00, 0x00, 0x00, 0x00, 0x00, 0x00, 0x00, 0x00, 0x00, 0x00, 0x00, 0x00, 0x00, 
0x00, 0x00, 0x00, 0x00, 0x00, 0x00, 0x00, 0x00, 0x00, 0x00, 0x00, 0x00, 0x00, 0x00, 0x00, 0x00, 
0x00, 0x00, 0x00, 0x00, 0x00, 0x00, 0x00, 0x00, 0x00, 0x00, 0x00, 0x00, 0x00, 0x00, 0x00, 0x00, 
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0x00, 0x00, 0x00, 0x00, 0x00, 0x00, 0x00, 0x00, 0x00, 0x00, 0x00, 0x00, 0x00, 0x00, 0x00, 0x00
};

static const unsigned char PROGMEM Invader_Icon[] = 
{
// 'SpacePad_Invader', 128x32px
0x00, 0x00, 0x00, 0x00, 0x00, 0x00, 0x00, 0x00, 0x00, 0x00, 0x00, 0x00, 0x00, 0x00, 0x00, 0x00, 
0x00, 0x00, 0x00, 0x00, 0x00, 0x00, 0x00, 0x00, 0x00, 0x00, 0x00, 0x00, 0x00, 0x00, 0x00, 0x00, 
0x00, 0x00, 0x00, 0x00, 0x00, 0x00, 0x00, 0x00, 0x00, 0x00, 0x00, 0x00, 0x00, 0x00, 0x00, 0x00, 
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0x00, 0x00, 0x00, 0x00, 0x00, 0x00, 0x00, 0x00, 0x00, 0x00, 0x00, 0x00, 0x00, 0x00, 0x00, 0x00
};

static const unsigned char PROGMEM Charge_20[] = 
{
// 'Charge_20', 128x32px
0x00, 0x00, 0x00, 0x00, 0x00, 0x00, 0x00, 0x00, 0x00, 0x00, 0x00, 0x00, 0x00, 0x00, 0x00, 0x00, 
0x00, 0x00, 0x00, 0x00, 0x00, 0x00, 0x00, 0x00, 0x00, 0x00, 0x00, 0x00, 0x00, 0x00, 0x00, 0x00, 
0x00, 0x00, 0x00, 0x00, 0x00, 0x00, 0x00, 0x00, 0x00, 0x00, 0x00, 0x00, 0x00, 0x00, 0x00, 0x00, 
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0x00, 0x00, 0x00, 0x00, 0x00, 0x00, 0x00, 0x00, 0x00, 0x00, 0x00, 0x00, 0x00, 0x00, 0x00, 0x00
};

static const unsigned char PROGMEM Charge_40[] = 
{
// 'Charge_40', 128x32px
0x00, 0x00, 0x00, 0x00, 0x00, 0x00, 0x00, 0x00, 0x00, 0x00, 0x00, 0x00, 0x00, 0x00, 0x00, 0x00, 
0x00, 0x00, 0x00, 0x00, 0x00, 0x00, 0x00, 0x00, 0x00, 0x00, 0x00, 0x00, 0x00, 0x00, 0x00, 0x00, 
0x00, 0x00, 0x00, 0x00, 0x00, 0x00, 0x00, 0x00, 0x00, 0x00, 0x00, 0x00, 0x00, 0x00, 0x00, 0x00, 
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0x00, 0x00, 0x00, 0x00, 0x00, 0x00, 0x00, 0x00, 0x00, 0x00, 0x00, 0x00, 0x00, 0x00, 0x00, 0x00
};

static const unsigned char PROGMEM Charge_60[] = 
{
// 'Charge_60', 128x32px
0x00, 0x00, 0x00, 0x00, 0x00, 0x00, 0x00, 0x00, 0x00, 0x00, 0x00, 0x00, 0x00, 0x00, 0x00, 0x00, 
0x00, 0x00, 0x00, 0x00, 0x00, 0x00, 0x00, 0x00, 0x00, 0x00, 0x00, 0x00, 0x00, 0x00, 0x00, 0x00, 
0x00, 0x00, 0x00, 0x00, 0x00, 0x00, 0x00, 0x00, 0x00, 0x00, 0x00, 0x00, 0x00, 0x00, 0x00, 0x00, 
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0x00, 0x00, 0x00, 0x00, 0x00, 0x00, 0x00, 0x00, 0x00, 0x00, 0x00, 0x00, 0x00, 0x00, 0x00, 0x00
};

static const unsigned char PROGMEM Charge_80[] = 
{
// 'Charge_80', 128x32px
0x00, 0x00, 0x00, 0x00, 0x00, 0x00, 0x00, 0x00, 0x00, 0x00, 0x00, 0x00, 0x00, 0x00, 0x00, 0x00, 
0x00, 0x00, 0x00, 0x00, 0x00, 0x00, 0x00, 0x00, 0x00, 0x00, 0x00, 0x00, 0x00, 0x00, 0x00, 0x00, 
0x00, 0x00, 0x00, 0x00, 0x00, 0x00, 0x00, 0x00, 0x00, 0x00, 0x00, 0x00, 0x00, 0x00, 0x00, 0x00, 
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0x00, 0x00, 0x00, 0x00, 0x00, 0x00, 0x00, 0x00, 0x00, 0x00, 0x00, 0x00, 0x00, 0x00, 0x00, 0x00
};

static const unsigned char PROGMEM Charge_100[] = 
{
// 'Charge_100', 128x32px
0x00, 0x00, 0x00, 0x00, 0x00, 0x00, 0x00, 0x00, 0x00, 0x00, 0x00, 0x00, 0x00, 0x00, 0x00, 0x00, 
0x00, 0x00, 0x00, 0x00, 0x00, 0x00, 0x00, 0x00, 0x00, 0x00, 0x00, 0x00, 0x00, 0x00, 0x00, 0x00, 
0x00, 0x00, 0x00, 0x00, 0x00, 0x00, 0x00, 0x00, 0x00, 0x00, 0x00, 0x00, 0x00, 0x00, 0x00, 0x00, 
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0x00, 0x00, 0x00, 0x00, 0x00, 0x00, 0x00, 0x00, 0x00, 0x00, 0x00, 0x00, 0x00, 0x00, 0x00, 0x00
};

static const unsigned char PROGMEM Dots_1[] = 
{
// 'Dots_1', 21x2px
0x66, 0x66, 0x60, 0x66, 0x66, 0x60
};

static const unsigned char PROGMEM Dots_2[] = 
{
// 'Dots_2', 21x2px
0x33, 0x33, 0x30, 0x33, 0x33, 0x30
};

static const unsigned char PROGMEM Dots_3[] = 
{
// 'Dots_3', 21x2px
0x99, 0x99, 0x98, 0x99, 0x99, 0x98
};

static const unsigned char PROGMEM Dots_4[] = 
{
// 'Dots_4', 21x2px
0xcc, 0xcc, 0xc8, 0xcc, 0xcc, 0xc8
};

#define BOUNCE_WITH_PROMPT_DETECTION

#define SCREEN_WIDTH 128
#define SCREEN_HEIGHT 32
#define OLED_RESET -1
Adafruit_SSD1306 display(SCREEN_WIDTH, SCREEN_HEIGHT, &Wire, OLED_RESET);
bool isOLEDon = false;


// -------------------------
// Buttons
// -------------------------

#define BUTTON_A_PIN 6       // BUTTON_1
#define BUTTON_B_PIN 7       // BUTTON_2
#define BUTTON_X_PIN 17      // BUTTON_3
#define BUTTON_Y_PIN 16      // BUTTON_4

#define BUTTON_5_PIN 10      // BUTTON_5
#define BUTTON_6_PIN 18      // BUTTON_6
#define BUTTON_7_PIN 39      // BUTTON_7
#define BUTTON_8_PIN 40      // BUTTON_8
#define BUTTON_9_PIN 15      // BUTTON_9

#define BUTTON_15_PIN 48     // BUTTON_15
#define BUTTON_16_PIN 41     // BUTTON_16
#define BUTTON_18_PIN 42     // BUTTON_18

// Right stick press
#define RIGHT_STICK_PRESS_PIN 14


// -------------------------
// D-pad
// -------------------------

#define HAT_LEFT_PIN  38
#define HAT_DOWN_PIN  13
#define HAT_RIGHT_PIN 45
#define HAT_UP_PIN    21


// -------------------------
// Left analog stick
// -------------------------

#define JOYSTICK_X_PIN 2
#define JOYSTICK_Y_PIN 1


// -------------------------
// Right analog stick
// -------------------------

#define RIGHT_JOYSTICK_X_PIN 12
#define RIGHT_JOYSTICK_Y_PIN 11


// -------------------------
// Debouncers
// -------------------------

Bounce debouncerA = Bounce();
Bounce debouncerB = Bounce();
Bounce debouncerX = Bounce();
Bounce debouncerY = Bounce();

Bounce debouncer5 = Bounce();
Bounce debouncer6 = Bounce();
Bounce debouncer7 = Bounce();
Bounce debouncer8 = Bounce();
Bounce debouncer9 = Bounce();

Bounce debouncer15 = Bounce();
Bounce debouncer16 = Bounce();
Bounce debouncer18 = Bounce();

Bounce debouncerRightStickPress = Bounce();

Bounce debouncerHatLeft = Bounce();
Bounce debouncerHatDown = Bounce();
Bounce debouncerHatRight = Bounce();
Bounce debouncerHatUp = Bounce();


// -------------------------
// BLE Gamepad
// -------------------------

BleGamepadConfiguration bleGamepadConfig;

BleGamepad bleGamepad(
    "ESP32 BLE GamePad",
    "Nevolta Systems",
    100
);


// -------------------------
// Joystick mapping
// -------------------------

int mapJoystick(int value, int center)
{
    const int deadzone = 100;

    if (value > center - deadzone &&
        value < center + deadzone)
    {
        return 0;
    }

    if (value < center)
    {
        return map(
            value,
            0,
            center - deadzone,
            -32767,
            0
        );
    }
    else
    {
        return map(
            value,
            center + deadzone,
            4095,
            0,
            32767
        );
    }
}

void wakeOLED(){
    previousMillis = millis();
    display.ssd1306_command(SSD1306_DISPLAYON);
    isOLEDon = true;
}

void initializeGamePad(){
    wakeOLED();
    // -------------------------
    // BLE Gamepad configuration
    // -------------------------

    bleGamepadConfig.setAutoReport(false);
    bleGamepadConfig.setAxesMin(-32767);
    bleGamepadConfig.setAxesMax(32767);

    bleGamepad.begin(&bleGamepadConfig);


    // -------------------------
    // Buttons
    // -------------------------

    pinMode(BUTTON_A_PIN, INPUT_PULLUP);
    debouncerA.attach(BUTTON_A_PIN);
    debouncerA.interval(25);

    pinMode(BUTTON_B_PIN, INPUT_PULLUP);
    debouncerB.attach(BUTTON_B_PIN);
    debouncerB.interval(25);

    pinMode(BUTTON_X_PIN, INPUT_PULLUP);
    debouncerX.attach(BUTTON_X_PIN);
    debouncerX.interval(25);

    pinMode(BUTTON_Y_PIN, INPUT_PULLUP);
    debouncerY.attach(BUTTON_Y_PIN);
    debouncerY.interval(25);

    pinMode(BUTTON_5_PIN, INPUT_PULLUP);
    debouncer5.attach(BUTTON_5_PIN);
    debouncer5.interval(25);

    pinMode(BUTTON_6_PIN, INPUT_PULLUP);
    debouncer6.attach(BUTTON_6_PIN);
    debouncer6.interval(25);

    pinMode(BUTTON_7_PIN, INPUT_PULLUP);
    debouncer7.attach(BUTTON_7_PIN);
    debouncer7.interval(25);

    pinMode(BUTTON_8_PIN, INPUT_PULLUP);
    debouncer8.attach(BUTTON_8_PIN);
    debouncer8.interval(25);

    pinMode(BUTTON_9_PIN, INPUT_PULLUP);
    debouncer9.attach(BUTTON_9_PIN);
    debouncer9.interval(25);

    pinMode(BUTTON_15_PIN, INPUT_PULLUP);
    debouncer15.attach(BUTTON_15_PIN);
    debouncer15.interval(25);

    pinMode(BUTTON_16_PIN, INPUT_PULLUP);
    debouncer16.attach(BUTTON_16_PIN);
    debouncer16.interval(25);

    pinMode(BUTTON_18_PIN, INPUT_PULLUP);
    debouncer18.attach(BUTTON_18_PIN);
    debouncer18.interval(25);


    // -------------------------
    // Right stick press
    // -------------------------

    pinMode(RIGHT_STICK_PRESS_PIN, INPUT_PULLUP);

    debouncerRightStickPress.attach(RIGHT_STICK_PRESS_PIN);
    debouncerRightStickPress.interval(25);


    // -------------------------
    // D-pad
    // -------------------------

    pinMode(HAT_LEFT_PIN, INPUT_PULLUP);
    pinMode(HAT_DOWN_PIN, INPUT_PULLUP);
    pinMode(HAT_RIGHT_PIN, INPUT_PULLUP);
    pinMode(HAT_UP_PIN, INPUT_PULLUP);

    debouncerHatLeft.attach(HAT_LEFT_PIN);
    debouncerHatLeft.interval(25);

    debouncerHatDown.attach(HAT_DOWN_PIN);
    debouncerHatDown.interval(25);

    debouncerHatRight.attach(HAT_RIGHT_PIN);
    debouncerHatRight.interval(25);

    debouncerHatUp.attach(HAT_UP_PIN);
    debouncerHatUp.interval(25);

    display.clearDisplay();
    display.setTextColor(WHITE);
    display.drawBitmap(0, 0, SpacePad_Logo, 128, 32, 1);
    display.display();
    delay(1500);
    for (int i = 64; i > -15; i--) {
        display.drawBitmap(i*2, 0, Invader_Icon, 128, 32, 1, 0);
        display.display();
        delay(25);
    }
    delay(200);
    display.clearDisplay();
    display.display();
    wakeOLED();
}

void setup()
{
    // -------------------------
    // ADC
    // -------------------------

    analogReadResolution(12);
    analogSetPinAttenuation(BATTERY_ADC_PIN, ADC_11db);
    analogSetPinAttenuation(CHARGE_ADC_PIN, ADC_11db);

    Wire.begin();
    display.begin(SSD1306_SWITCHCAPVCC, 0x3C);
    display.clearDisplay();
    display.display();

    float chargeRaw = analogRead(CHARGE_ADC_PIN);
    if(chargeRaw > 2045){
        chargingMode = true;
        pinMode(BUTTON_18_PIN, INPUT_PULLUP);
        debouncer18.attach(BUTTON_18_PIN);
        debouncer18.interval(25);
        wakeOLED();
    }else{
        chargingMode = false;
        initializeGamePad();
    }

    Serial.begin(115200);
}


void loop()
{
    float adcRaw = analogRead(BATTERY_ADC_PIN);
    float batteryPerc = (adcRaw / 4095.0f) * 100;

    unsigned long currentMillis = millis();
    debouncer18.update();

    if (debouncer18.fell() && isOLEDon == false){
        wakeOLED();
    }

    if(chargingMode == false){
            
        bool currentPairedState = false;
        // -------------------------
        // Update debouncers
        // -------------------------

        debouncerA.update();
        debouncerB.update();
        debouncerX.update();
        debouncerY.update();

        debouncer5.update();
        debouncer6.update();
        debouncer7.update();
        debouncer8.update();
        debouncer9.update();

        debouncer15.update();
        debouncer16.update();

        debouncerRightStickPress.update();

        debouncerHatLeft.update();
        debouncerHatDown.update();
        debouncerHatRight.update();
        debouncerHatUp.update();


        // Battery Info on display
        bleGamepad.setBatteryLevel(batteryPerc);
        bleGamepad.setPowerLevel(POWER_STATE_GOOD);

        if(isOLEDon == true){
            display.fillRect(93, 0, 35, 10, BLACK);
            if(batteryPerc >= 80){
                display.drawBitmap(108, 0, Batt_100, 20, 10, 1);
            }else if(batteryPerc >= 60){
                display.drawBitmap(108, 0, Batt_80, 20, 10, 1);
            }else if(batteryPerc >= 40){
                display.drawBitmap(108, 0, Batt_60, 20, 10, 1);
            }else if(batteryPerc >= 20){
                display.drawBitmap(108, 0, Batt_40, 20, 10, 1);
            }else{
                display.drawBitmap(108, 0, Batt_20, 20, 10, 1);
            }
        }

        if(batteryPerc >= 20){
            bleGamepad.setPowerLevel(POWER_STATE_CRITICAL);
        }
        
        float chargeRaw = analogRead(CHARGE_ADC_PIN);
        if(chargeRaw > 2045){
            bleGamepad.setChargingState(POWER_STATE_CHARGING);
            if(isOLEDon == true){
                display.drawBitmap(93, 0, Batt_Charge, 10, 10, 1);
            }
        }else{
            bleGamepad.setChargingState(POWER_STATE_NOT_CHARGING);
        }

        if (bleGamepad.isConnected())
        {
            currentPairedState = true;

            // -------------------------
            // BUTTON 1 - A
            // -------------------------

            if (debouncerA.fell())
                bleGamepad.press(BUTTON_1);

            if (debouncerA.rose())
                bleGamepad.release(BUTTON_1);


            // -------------------------
            // BUTTON 2 - B
            // -------------------------

            if (debouncerB.fell())
                bleGamepad.press(BUTTON_2);

            if (debouncerB.rose())
                bleGamepad.release(BUTTON_2);


            // -------------------------
            // BUTTON 3 - X
            // -------------------------

            if (debouncerX.fell())
                bleGamepad.press(BUTTON_3);

            if (debouncerX.rose())
                bleGamepad.release(BUTTON_3);


            // -------------------------
            // BUTTON 4 - Y
            // -------------------------

            if (debouncerY.fell())
                bleGamepad.press(BUTTON_4);

            if (debouncerY.rose())
                bleGamepad.release(BUTTON_4);


            // -------------------------
            // BUTTON 5
            // -------------------------

            if (debouncer5.fell())
                bleGamepad.press(BUTTON_5);

            if (debouncer5.rose())
                bleGamepad.release(BUTTON_5);


            // -------------------------
            // BUTTON 6
            // -------------------------

            if (debouncer6.fell())
                bleGamepad.press(BUTTON_6);

            if (debouncer6.rose())
                bleGamepad.release(BUTTON_6);


            // -------------------------
            // BUTTON 7
            // -------------------------

            if (debouncer7.fell())
                bleGamepad.press(BUTTON_7);

            if (debouncer7.rose())
                bleGamepad.release(BUTTON_7);


            // -------------------------
            // BUTTON 8
            // -------------------------

            if (debouncer8.fell())
                bleGamepad.press(BUTTON_8);

            if (debouncer8.rose())
                bleGamepad.release(BUTTON_8);


            // -------------------------
            // BUTTON 9
            // -------------------------

            if (debouncer9.fell())
                bleGamepad.press(BUTTON_9);

            if (debouncer9.rose())
                bleGamepad.release(BUTTON_9);


            // -------------------------
            // BUTTON 15
            // -------------------------

            if (debouncer15.fell())
                bleGamepad.press(BUTTON_15);

            if (debouncer15.rose())
                bleGamepad.release(BUTTON_15);


            // -------------------------
            // BUTTON 16
            // -------------------------

            if (debouncer16.fell())
                bleGamepad.press(BUTTON_16);

            if (debouncer16.rose())
                bleGamepad.release(BUTTON_16);


            // -------------------------
            // BUTTON 18
            // -------------------------

            if (debouncer18.fell())
            {
                bleGamepad.press(BUTTON_11);
                if(isOLEDon == false){
                    wakeOLED();
                }
            }

            if (debouncer18.rose())
            {
                bleGamepad.release(BUTTON_11);
            }


            // -------------------------
            // RIGHT STICK PRESS
            // -------------------------

            if (debouncerRightStickPress.fell())
                bleGamepad.press(BUTTON_10);

            if (debouncerRightStickPress.rose())
                bleGamepad.release(BUTTON_10);


            // -------------------------
            // D-pad
            // -------------------------

            bool left  = debouncerHatLeft.read()  == LOW;
            bool down  = debouncerHatDown.read()  == LOW;
            bool right = debouncerHatRight.read() == LOW;
            bool up    = debouncerHatUp.read()    == LOW;


            if (up && right)
            {
                bleGamepad.setHat1(HAT_UP_RIGHT);
            }
            else if (up && left)
            {
                bleGamepad.setHat1(HAT_UP_LEFT);
            }
            else if (down && right)
            {
                bleGamepad.setHat1(HAT_DOWN_RIGHT);
            }
            else if (down && left)
            {
                bleGamepad.setHat1(HAT_DOWN_LEFT);
            }
            else if (up)
            {
                bleGamepad.setHat1(HAT_UP);
            }
            else if (down)
            {
                bleGamepad.setHat1(HAT_DOWN);
            }
            else if (left)
            {
                bleGamepad.setHat1(HAT_LEFT);
            }
            else if (right)
            {
                bleGamepad.setHat1(HAT_RIGHT);
            }
            else
            {
                bleGamepad.setHat1(HAT_CENTERED);
            }


            // -------------------------
            // LEFT ANALOG STICK
            // -------------------------

            int leftX = analogRead(JOYSTICK_X_PIN);
            int leftY = analogRead(JOYSTICK_Y_PIN);

            int leftXMapped = -mapJoystick(leftX, 1960);
            int leftYMapped = mapJoystick(leftY, 1960);


            // -------------------------
            // RIGHT ANALOG STICK
            // -------------------------

            int rightX = analogRead(RIGHT_JOYSTICK_X_PIN);
            int rightY = analogRead(RIGHT_JOYSTICK_Y_PIN);

            int rightXMapped = -mapJoystick(rightX, 1960);
            int rightYMapped = mapJoystick(rightY, 1960);


            // -------------------------
            // Send both sticks
            // -------------------------

            bleGamepad.setAxes(
                leftXMapped,     // X
                leftYMapped,     // Y
                rightXMapped,    // Z
                0,               // RX
                rightYMapped,    // RY
                0                // RZ
            );


            // -------------------------
            // Send report
            // -------------------------
            
            bleGamepad.sendReport();


            // -------------------------
            // Debug
            // -------------------------

            /*
            Serial.printf(
                "L: X%d Y%d | R: X%d Y%d\n",
                leftX,
                leftY,
                rightX,
                rightY
            );
            */
        }

        if(lastPairedState == false){
            if(currentPairedState == true){
                wakeOLED();
                display.setTextSize(1);
                display.fillRect(5, 15, 90, 10, BLACK);
                display.setCursor(5, 15);
                String scrText = "Device paired!";
                for(int i = 0; i < scrText.length(); i++){
                    display.print(scrText[i]);
                    display.display();
                    delay(75);
                }
                delay(3000);
                display.fillRect(5, 15, 90, 10, BLACK);
                display.display();
            }else {
                if(isOLEDon == true){
                    display.fillRect(5, 15, 90, 10, BLACK);
                    display.setTextSize(1);
                    display.setCursor(5, 15);
                    display.print("Searching");
                    display.display();
                    delay(300);
                    for(int i = 0; i < 3; i++){
                        display.print(".");
                        display.display();
                        delay(300);
                    }   
                }
            }
        }
        if(isOLEDon == true){
            display.display();
        }
        lastPairedState = currentPairedState;
    }else{
        if(currentMillis - bat_previousMillis >= bat_interval){
            bat_previousMillis = currentMillis;
            float chargeRaw = analogRead(CHARGE_ADC_PIN);

            if(isOLEDon == true){
                display.clearDisplay();

                if(batteryPerc >= 80){
                    display.drawBitmap(0, 0, Charge_100, 128, 32, 1);
                    display.display();
                }else{
                    if(batteryPerc >= 60){
                        display.drawBitmap(0, 0, Charge_80, 128, 32, 1);
                    }else if(batteryPerc >= 40){
                        display.drawBitmap(0, 0, Charge_60, 128, 32, 1);
                    }else if(batteryPerc >= 20){
                        display.drawBitmap(0, 0, Charge_40, 128, 32, 1);
                    }else{
                        display.drawBitmap(0, 0, Charge_20, 128, 32, 1);
                    }
                    display.drawBitmap(20, 15, Dots_1, 21, 2, 1, 0);
                    display.display();
                    delay(250);
                    display.drawBitmap(20, 15, Dots_2, 21, 2, 1, 0);
                    display.display();
                    delay(250);
                    display.drawBitmap(20, 15, Dots_3, 21, 2, 1, 0);
                    display.display();
                    delay(250);
                    display.drawBitmap(20, 15, Dots_4, 21, 2, 1, 0);
                    display.display();
                    delay(250);
                }
            }

            if(chargeRaw < 2045){
                chargingMode = false;
                initializeGamePad();
            }
        }
    }

    if(isOLEDon == true){
        if (currentMillis - previousMillis >= interval)
        {
            previousMillis = currentMillis;
            display.ssd1306_command(SSD1306_DISPLAYOFF);
            isOLEDon = false;
        }
    }
}